## esp/sdkconfig.defaults
```kconfig
# Flash size 4MB
CONFIG_ESPTOOLPY_FLASHSIZE_4MB=y
CONFIG_ESPTOOLPY_FLASHSIZE="4MB"

# ESP32 target
CONFIG_IDF_TARGET_ESP32=y

# SPI
CONFIG_SPI_MASTER_ISR_IN_IRAM=y

# UART
CONFIG_UART_ISR_IN_IRAM=y

# FreeRTOS tick rate 1000 Hz (for lv_tick_inc)
CONFIG_FREERTOS_HZ=1000

# Main task stack
CONFIG_ESP_MAIN_TASK_STACK_SIZE=8192

# Disable console on UART0 (free UART0 for serial data from PC)
CONFIG_ESP_CONSOLE_NONE=y
```
